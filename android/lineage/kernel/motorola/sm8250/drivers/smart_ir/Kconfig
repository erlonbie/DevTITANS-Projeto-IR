## android/lineage/kernel/motorola/sm8250/drivers/smart_ir/Kconfig
```kconfig
config SMARTIR
 tristate "smart_ir module"
 default m
 depends on MODULES
 help
   smart_ir is a test device used in DevTITANS course.
```
